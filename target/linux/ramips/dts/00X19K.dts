// SPDX-License-Identifier: GPL-2.0-or-later OR MIT
/dts-v1/;

#include "Amped-Wireless.dtsi"

/ {
	compatible = "ampedwireless,ally-00x19k", "mediatek,mt7621-soc";
	model = "Amped Wireless ALLY 00X19K";

};

&ethernet {
	mtd-mac-address = <&factory 0x4>;

	/* valid VLAN portmaps for mt7530 are "llllw", "wllll", and "lwlll" */
	mediatek,portmap = "ll";

};
